## boards/shields/stm32f401_x220/Kconfig.defconfig
```kconfig
# Copyright (c) 2020 The ZMK Contributors
# SPDX-License-Identifier: MIT

if SHIELD_STM32F401_X220

config ZMK_KEYBOARD_NAME
    default "stm32_x220"

endif
```

## boards/shields/stm32f401_x220/Kconfig.shield
```kconfig
# Copyright (c) 2020 The ZMK Contributors
# SPDX-License-Identifier: MIT

config STM32F401_X220
    def_bool $(shields_list_contains,stm32f401_x220)
```
